/**
 * @cliArgs --board "/boards/LAUNCHXL_F28379D" --context "CPU1" --product "C2000WARE@5.00.00.00"
 * @versions {"tool":"1.17.0+3128"}
 */

/**
 * Import the modules used in this configuration.
 */
const led       = scripting.addModule("/driverlib/board_components/led", {}, false);
const led1      = led.addInstance();
const led2      = led.addInstance();
const cputimer  = scripting.addModule("/driverlib/cputimer.js", {}, false);
const cputimer1 = cputimer.addInstance();
const sci       = scripting.addModule("/driverlib/sci.js", {}, false);
const sci1      = sci.addInstance();

/**
 * Write custom configuration values to the imported modules.
 */
led1.$name                  = "myBoardLED0";
led1.$hardware              = system.deviceData.board.components.LED4;
led1.gpio.writeInitialValue = true;
led1.gpio.initialValue      = 1;

led2.$name     = "myBoardLED1";
led2.$hardware = system.deviceData.board.components.LED5;

cputimer1.$name                    = "Led_Toggle_Timer";
cputimer1.timerPeriod              = 100000000;
cputimer1.enableInterrupt          = true;
cputimer1.registerInterrupts       = true;
cputimer1.startTimer               = true;
cputimer1.timerInt.enableInterrupt = true;

sci1.$name                 = "sci_modbus";
sci1.sci.$assign           = "SCIA";
sci1.sci.scirxdPin.$assign = "GPIO43";
sci1.sci.scitxdPin.$assign = "GPIO42";
scripting.suppress("Not pinned out,@@@.+?@@@ is not pinned out on the LaunchPad F28379D\\.  @@@.+?@@@", sci1.sci, "scirxdPin");
scripting.suppress("Not pinned out,@@@.+?@@@ is not pinned out on the LaunchPad F28379D\\.  @@@.+?@@@", sci1.sci, "scitxdPin");

/**
 * Pinmux solution for unlocked pins/peripherals. This ensures that minor changes to the automatic solver in a future
 * version of the tool will not impact the pinmux you originally saw.  These lines can be completely deleted in order to
 * re-solve from scratch.
 */
led1.gpio.gpioPin.$suggestSolution = "GPIO31";
led2.gpio.gpioPin.$suggestSolution = "GPIO34";
